## configs/swift-linux-arm64_defconfig
```kconfig
# CPU Architecture
BR2_aarch64=y

# GNU C Toolchain
BR2_KERNEL_HEADERS_4_19=y
BR2_TOOLCHAIN_BUILDROOT_GLIBC=y
BR2_TOOLCHAIN_BUILDROOT_CXX=y
BR2_INSTALL_LIBSTDCPP=y

# Vendor
BR2_TOOLCHAIN_BUILDROOT_VENDOR="swift"
BR2_TARGET_GENERIC_HOSTNAME="swift-linux"
BR2_TARGET_GENERIC_ISSUE="Welcome to Swift Linux"

# Swift Runtime Libraries
#BR2_PACKAGE_SWIFT=y
#BR2_PACKAGE_LIBSWIFTDISPATCH=y
#BR2_PACKAGE_FOUNDATION=y

# Networking
BR2_PACKAGE_LIBCURL=y
BR2_PACKAGE_AVAHI=y
BR2_PACKAGE_AVAHI_LIBDNSSD_COMPATIBILITY=y

# Crypto
BR2_PACKAGE_OPENSSL=y
BR2_PACKAGE_LIBTASN1=y

# Compression
BR2_PACKAGE_BZIP2=y
BR2_PACKAGE_XZ=y
BR2_PACKAGE_ZIP=y
BR2_PACKAGE_UNZIP=y
BR2_PACKAGE_ZSTD=y
BR2_PACKAGE_P7ZIP=y
BR2_PACKAGE_ZLIB=y
BR2_PACKAGE_LZ4=y

# Wayland
BR2_PACKAGE_WAYLAND=y
BR2_PACKAGE_WAYLAND_PROTOCOLS=y
BR2_PACKAGE_WLROOTS=y
BR2_PACKAGE_LIBINPUT=y

# X11
BR2_PACKAGE_XORG7=y
BR2_PACKAGE_WLROOTS_X11=y
BR2_PACKAGE_WLROOTS_XWAYLAND=y
BR2_PACKAGE_LIBXCB=y
BR2_PACKAGE_XLIB_LIBX11=y
BR2_PACKAGE_XLIB_LIBXCURSOR=y
BR2_PACKAGE_XLIB_LIBXEXT=y
BR2_PACKAGE_XLIB_LIBXI=y
BR2_PACKAGE_XLIB_LIBXMU=y

# OpenGL
BR2_PACKAGE_LIBDRM=y
BR2_PACKAGE_MESA3D=y
BR2_PACKAGE_MESA3D_GBM=y
BR2_PACKAGE_MESA3D_OPENGL=y
BR2_PACKAGE_MESA3D_OPENGL_ES=y
BR2_PACKAGE_MESA3D_OPENGL_EGL=y
BR2_PACKAGE_MESA3D_OPENGL_GLX=y
BR2_PACKAGE_MESA3D_GALLIUM_DRIVER_VIRGL=y
BR2_PACKAGE_LIBGLU=y
BR2_PACKAGE_LIBGLEW=y
BR2_PACKAGE_LIBGLFW=y
BR2_PACKAGE_LIBFREEGLUT=y
BR2_PACKAGE_LIBEPOXY=y
BR2_PACKAGE_LIBGLVND=y

# Vulkan
BR2_PACKAGE_VULKAN_HEADERS=y

# SDL
BR2_PACKAGE_SDL2=y
BR2_PACKAGE_SDL2_KMSDRM=y
BR2_PACKAGE_SDL2_X11=y
BR2_PACKAGE_SDL2_WAYLAND=y
BR2_PACKAGE_SDL2_OPENGL=y
BR2_PACKAGE_SDL2_OPENGLES=y
BR2_PACKAGE_SDL2_GFX=y
BR2_PACKAGE_SDL2_IMAGE=y
BR2_PACKAGE_SDL2_MIXER=y
BR2_PACKAGE_SDL2_NET=y
BR2_PACKAGE_SDL2_TTF=y

# Cairo
BR2_PACKAGE_CAIRO=y
BR2_PACKAGE_CAIRO_PS=y
BR2_PACKAGE_CAIRO_SVG=y
BR2_PACKAGE_CAIRO_PNG=y
BR2_PACKAGE_CAIRO_TEE=y
BR2_PACKAGE_CAIRO_XML=y
BR2_PACKAGE_CAIRO_SCRIPT=y
BR2_PACKAGE_CAIRO_SCRIPT_INTERPRETER=y

# Fonts
BR2_PACKAGE_PIXMAN=y
BR2_PACKAGE_FONTCONFIG=y
BR2_PACKAGE_HARFBUZZ=y
BR2_PACKAGE_LCMS2=y
BR2_PACKAGE_PANGO=y
BR2_PACKAGE_WOFF2=y

# Image
BR2_PACKAGE_LIBPNG=y
BR2_PACKAGE_JPEG=y
BR2_PACKAGE_JPEG_TURBO=y
BR2_PACKAGE_OPENJPEG=y
BR2_PACKAGE_TIFF=y
BR2_PACKAGE_LIBRAW=y
BR2_PACKAGE_WEBP=y
BR2_PACKAGE_WEBP_MUX=y
BR2_PACKAGE_WEBP_DEMUX=y
BR2_PACKAGE_LIBFREEIMAGE=y
BR2_PACKAGE_GIFLIB=y

# Multimedia
BR2_PACKAGE_ALSA_LIB=y
BR2_PACKAGE_OPENAL=y
BR2_PACKAGE_LIBMAD=y
BR2_PACKAGE_LIBID3TAG=y
BR2_PACKAGE_LIBVORBIS=y
BR2_PACKAGE_LIBOGG=y
BR2_PACKAGE_LIBTHEORA=y
BR2_PACKAGE_OPUS=y
BR2_PACKAGE_FLAC=y
BR2_PACKAGE_LIBOPUSENC=y
BR2_PACKAGE_LIBMPEG2=y
BR2_PACKAGE_LIBOPENH264=y
BR2_PACKAGE_LIBDE265=y
BR2_PACKAGE_LIBHEIF=y
BR2_PACKAGE_LIBMATROSKA=y
BR2_PACKAGE_X264=y
BR2_PACKAGE_X265=y
BR2_PACKAGE_LIBYUV=y
BR2_PACKAGE_FLUID_SOUNDFONT=y
BR2_PACKAGE_FLUIDSYNTH=y
BR2_PACKAGE_FLUIDSYNTH_SDL2=y
BR2_PACKAGE_LIBAACS=y
BR2_PACKAGE_DAV1D=y
BR2_PACKAGE_FAAD2=y
BR2_PACKAGE_LIBMODPLUG=y
BR2_PACKAGE_LIBXMP=y
BR2_PACKAGE_FFMPEG=y

# GStreamer
BR2_PACKAGE_GSTREAMER1=y
BR2_PACKAGE_GST1_LIBAV=y
BR2_PACKAGE_GST1_PLUGINS_BAD=y
BR2_PACKAGE_GST1_PLUGINS_BAD_PLUGIN_DEBUGUTILS=y
BR2_PACKAGE_GST1_PLUGINS_BAD_PLUGIN_MPEGTSDEMUX=y
BR2_PACKAGE_GST1_PLUGINS_BAD_PLUGIN_SUBENC=y
BR2_PACKAGE_GST1_PLUGINS_BASE=y
BR2_PACKAGE_GST1_PLUGINS_BASE_PLUGIN_ALSA=y
BR2_PACKAGE_GST1_PLUGINS_BASE_PLUGIN_APP=y
BR2_PACKAGE_GST1_PLUGINS_BASE_PLUGIN_AUDIOCONVERT=y
BR2_PACKAGE_GST1_PLUGINS_BASE_PLUGIN_AUDIORESAMPLE=y
BR2_PACKAGE_GST1_PLUGINS_BASE_PLUGIN_PLAYBACK=y
BR2_PACKAGE_GST1_PLUGINS_BASE_PLUGIN_VIDEOCONVERTSCALE=y
BR2_PACKAGE_GST1_PLUGINS_BASE_PLUGIN_VOLUME=y
BR2_PACKAGE_GST1_PLUGINS_GOOD=y
BR2_PACKAGE_GST1_PLUGINS_GOOD_PLUGIN_AUDIOFX=y
BR2_PACKAGE_GST1_PLUGINS_GOOD_PLUGIN_AUTODETECT=y
BR2_PACKAGE_GST1_PLUGINS_GOOD_PLUGIN_ISOMP4=y
BR2_PACKAGE_GST1_PLUGINS_GOOD_PLUGIN_MATROSKA=y
BR2_PACKAGE_GST1_PLUGINS_GOOD_PLUGIN_RTSP=y
BR2_PACKAGE_GST1_PLUGINS_GOOD_PLUGIN_VPX=y
BR2_PACKAGE_GST1_PLUGINS_BASE_LIB_OPENGL_OPENGL=y
BR2_PACKAGE_GST1_PLUGINS_BASE_LIB_OPENGL_GLES2=y

# Misc
BR2_PACKAGE_ICU=y
BR2_PACKAGE_LIBBSD=y
BR2_PACKAGE_LIBMD=y
BR2_PACKAGE_LIBEDIT=y
BR2_PACKAGE_DBUS=y
BR2_PACKAGE_NCURSES=y
BR2_PACKAGE_LIBFRIBIDI=y
BR2_PACKAGE_PCRE=y
BR2_PACKAGE_PCRE_UCP=y

# Serialization / Persistence
BR2_PACKAGE_SQLITE=y
BR2_PACKAGE_LIBXML2=y
BR2_PACKAGE_LIBXSLT=y

# Hardware
BR2_PACKAGE_LIBNFC=y
BR2_PACKAGE_LIBUSB=y
BR2_PACKAGE_LIBCAMERA=y
BR2_PACKAGE_LIBCEC=y
BR2_PACKAGE_LIBCEC_LINUX_API=y
BR2_PACKAGE_EDID_DECODE=y
BR2_PACKAGE_READ_EDID=y
BR2_PACKAGE_CUPS=y
```

## package/games/hl2/Config.in
```kconfig
config BR2_PACKAGE_HL2
    bool "hl2"
    select BR2_PACKAGE_SDL2
    select BR2_PACKAGE_OPENAL
    select BR2_PACKAGE_GL4ES    if (!BR2_PACKAGE_HAS_LIBGL) && BR2_PACKAGE_HAS_LIBGLES
    help
      Source is a 3D game engine developed by Valve. It debuted as the successor to GoldSrc with Half-Life: Source in June 2004.
      
      https://github.com/nillerusr/source-engine
```

## package/games/super-video-golf/Config.in
```kconfig
config BR2_PACKAGE_SUPER_VIDEO_GOLF
	bool "super-video-golf"
	select BR2_PACKAGE_SDL2
	select BR2_PACKAGE_SDL2_OPENGL
	select BR2_PACKAGE_OPENAL
	select BR2_PACKAGE_OPUS
	select BR2_PACKAGE_SQLITE
	select BR2_PACKAGE_LIBCURL
	select BR2_PACKAGE_LIBUNWIND
	select BR2_PACKAGE_BULLET
	select BR2_PACKAGE_TBB
	help
	  Super Video Golf is a local or networked multiplayer golfing sim, modeled on 90s era console and DOS games. 
	  The game supports 8 players locally (on the same computer) with 4 controller support, hot seat keyboard play or a mixture of both.

	  https://github.com/fallahn/crogine
```

## package/libs/graphene/Config.in
```kconfig
config BR2_PACKAGE_GRAPHENE
	bool "graphene"
	depends on BR2_USE_WCHAR
	depends on BR2_TOOLCHAIN_HAS_THREADS
	depends on BR2_USE_MMU
	help
	  A thin layer of types for graphic libraries

	  https://github.com/ebassi/graphene
```

## package/libs/iso-codes/Config.in
```kconfig
config BR2_PACKAGE_ISO_CODES
	bool "iso-codes"
	help
	  This project provides lists of various ISO standards (countries, languages, language scripts, and currency names) in one place. 
	  It also provides their translations in gettext .po format.

	  https://salsa.debian.org/iso-codes-team/iso-codes
```
