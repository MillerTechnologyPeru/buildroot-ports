## Config.in
```kconfig
menu "Swift Linux Ports"

menu "apps"

    source "$BR2_EXTERNAL_SWIFTLINUXPORTS_PATH/package/apps/epiphany/Config.in"
    source "$BR2_EXTERNAL_SWIFTLINUXPORTS_PATH/package/apps/chicago95/Config.in"
    source "$BR2_EXTERNAL_SWIFTLINUXPORTS_PATH/package/apps/decibels/Config.in"
    source "$BR2_EXTERNAL_SWIFTLINUXPORTS_PATH/package/apps/gnome-calculator/Config.in"
    source "$BR2_EXTERNAL_SWIFTLINUXPORTS_PATH/package/apps/gnome-calendar/Config.in"
    source "$BR2_EXTERNAL_SWIFTLINUXPORTS_PATH/package/apps/gnome-console/Config.in"
    source "$BR2_EXTERNAL_SWIFTLINUXPORTS_PATH/package/apps/gnome-control-center/Config.in"
    source "$BR2_EXTERNAL_SWIFTLINUXPORTS_PATH/package/apps/gnome-disk-utility/Config.in"
    source "$BR2_EXTERNAL_SWIFTLINUXPORTS_PATH/package/apps/gnome-session/Config.in"
    source "$BR2_EXTERNAL_SWIFTLINUXPORTS_PATH/package/apps/gnome-settings-daemon/Config.in"
    source "$BR2_EXTERNAL_SWIFTLINUXPORTS_PATH/package/apps/gnome-shell/Config.in"
    source "$BR2_EXTERNAL_SWIFTLINUXPORTS_PATH/package/apps/gnome-software/Config.in"
    source "$BR2_EXTERNAL_SWIFTLINUXPORTS_PATH/package/apps/mutter/Config.in"
    source "$BR2_EXTERNAL_SWIFTLINUXPORTS_PATH/package/apps/nautilus/Config.in"
    source "$BR2_EXTERNAL_SWIFTLINUXPORTS_PATH/package/apps/showtime/Config.in"
    source "$BR2_EXTERNAL_SWIFTLINUXPORTS_PATH/package/apps/swaywm/Config.in"
    source "$BR2_EXTERNAL_SWIFTLINUXPORTS_PATH/package/apps/thunar/Config.in"
    source "$BR2_EXTERNAL_SWIFTLINUXPORTS_PATH/package/apps/xdg-desktop-portal/Config.in"
    source "$BR2_EXTERNAL_SWIFTLINUXPORTS_PATH/package/apps/xdg-desktop-portal-gnome/Config.in"
    source "$BR2_EXTERNAL_SWIFTLINUXPORTS_PATH/package/apps/xdg-desktop-portal-gtk/Config.in"
    source "$BR2_EXTERNAL_SWIFTLINUXPORTS_PATH/package/apps/xfce4-panel/Config.in"
    source "$BR2_EXTERNAL_SWIFTLINUXPORTS_PATH/package/apps/xfce4-session/Config.in"
    source "$BR2_EXTERNAL_SWIFTLINUXPORTS_PATH/package/apps/xfce4-settings/Config.in"
    source "$BR2_EXTERNAL_SWIFTLINUXPORTS_PATH/package/apps/xfdesktop/Config.in"
    source "$BR2_EXTERNAL_SWIFTLINUXPORTS_PATH/package/apps/xfwm4/Config.in"

endmenu

menu "daemons"

    source "$BR2_EXTERNAL_SWIFTLINUXPORTS_PATH/package/daemons/accountsservice/Config.in"
    source "$BR2_EXTERNAL_SWIFTLINUXPORTS_PATH/package/daemons/colord/Config.in"

endmenu

menu "games"

    source "$BR2_EXTERNAL_SWIFTLINUXPORTS_PATH/package/games/devilutionx/Config.in"
    source "$BR2_EXTERNAL_SWIFTLINUXPORTS_PATH/package/games/sdlpop/Config.in"
    source "$BR2_EXTERNAL_SWIFTLINUXPORTS_PATH/package/games/cannonball/Config.in"
    source "$BR2_EXTERNAL_SWIFTLINUXPORTS_PATH/package/games/xash3d/xash3d-fwgs/Config.in"
    source "$BR2_EXTERNAL_SWIFTLINUXPORTS_PATH/package/games/xash3d/hlsdk-xash3d/Config.in"
    source "$BR2_EXTERNAL_SWIFTLINUXPORTS_PATH/package/games/xash3d/hlsdk-xash3d-dmc/Config.in"
    source "$BR2_EXTERNAL_SWIFTLINUXPORTS_PATH/package/games/xash3d/hlsdk-xash3d-opfor/Config.in"
    source "$BR2_EXTERNAL_SWIFTLINUXPORTS_PATH/package/games/ecwolf/Config.in"
    source "$BR2_EXTERNAL_SWIFTLINUXPORTS_PATH/package/games/sonic2013/Config.in"
    source "$BR2_EXTERNAL_SWIFTLINUXPORTS_PATH/package/games/soniccd/Config.in"
    source "$BR2_EXTERNAL_SWIFTLINUXPORTS_PATH/package/games/sonic-mania/Config.in"
    source "$BR2_EXTERNAL_SWIFTLINUXPORTS_PATH/package/games/cdogs/Config.in"
    source "$BR2_EXTERNAL_SWIFTLINUXPORTS_PATH/package/games/abuse-data/Config.in"
    source "$BR2_EXTERNAL_SWIFTLINUXPORTS_PATH/package/games/abuse/Config.in"
    source "$BR2_EXTERNAL_SWIFTLINUXPORTS_PATH/package/games/hcl/Config.in"
    source "$BR2_EXTERNAL_SWIFTLINUXPORTS_PATH/package/games/gzdoom/Config.in"
    source "$BR2_EXTERNAL_SWIFTLINUXPORTS_PATH/package/games/eduke32/Config.in"
    source "$BR2_EXTERNAL_SWIFTLINUXPORTS_PATH/package/games/raze/Config.in"
    source "$BR2_EXTERNAL_SWIFTLINUXPORTS_PATH/package/games/ioquake3/Config.in"
    source "$BR2_EXTERNAL_SWIFTLINUXPORTS_PATH/package/games/corsixth/Config.in"
    source "$BR2_EXTERNAL_SWIFTLINUXPORTS_PATH/package/games/fheroes2/Config.in"
    source "$BR2_EXTERNAL_SWIFTLINUXPORTS_PATH/package/games/vcmi/Config.in"
    source "$BR2_EXTERNAL_SWIFTLINUXPORTS_PATH/package/games/tyrian/Config.in"
    source "$BR2_EXTERNAL_SWIFTLINUXPORTS_PATH/package/games/hurrican/Config.in"
    source "$BR2_EXTERNAL_SWIFTLINUXPORTS_PATH/package/games/openjazz/Config.in"
    source "$BR2_EXTERNAL_SWIFTLINUXPORTS_PATH/package/games/fallout1-ce/Config.in"
    source "$BR2_EXTERNAL_SWIFTLINUXPORTS_PATH/package/games/fallout2-ce/Config.in"
    source "$BR2_EXTERNAL_SWIFTLINUXPORTS_PATH/package/games/dxx-rebirth/Config.in"
    source "$BR2_EXTERNAL_SWIFTLINUXPORTS_PATH/package/games/hl2/Config.in"
    source "$BR2_EXTERNAL_SWIFTLINUXPORTS_PATH/package/games/super-video-golf/Config.in"
    source "$BR2_EXTERNAL_SWIFTLINUXPORTS_PATH/package/games/emulationstation/Config.in"
    source "$BR2_EXTERNAL_SWIFTLINUXPORTS_PATH/package/games/gmenu2x/Config.in"
    source "$BR2_EXTERNAL_SWIFTLINUXPORTS_PATH/package/games/heroic/Config.in"
    source "$BR2_EXTERNAL_SWIFTLINUXPORTS_PATH/package/games/libretro-dosbox-pure/Config.in"
    source "$BR2_EXTERNAL_SWIFTLINUXPORTS_PATH/package/games/libretro-easyrpg/Config.in"
    source "$BR2_EXTERNAL_SWIFTLINUXPORTS_PATH/package/games/libretro-fceumm/Config.in"
    source "$BR2_EXTERNAL_SWIFTLINUXPORTS_PATH/package/games/libretro-gambatte/Config.in"
    source "$BR2_EXTERNAL_SWIFTLINUXPORTS_PATH/package/games/libretro-lutro/Config.in"
    source "$BR2_EXTERNAL_SWIFTLINUXPORTS_PATH/package/games/libretro-mgba/Config.in"
    source "$BR2_EXTERNAL_SWIFTLINUXPORTS_PATH/package/games/libretro-minivmac/Config.in"
    source "$BR2_EXTERNAL_SWIFTLINUXPORTS_PATH/package/games/libretro-mu/Config.in"
    source "$BR2_EXTERNAL_SWIFTLINUXPORTS_PATH/package/games/libretro-pcsx-rearmed/Config.in"
    source "$BR2_EXTERNAL_SWIFTLINUXPORTS_PATH/package/games/libretro-scummvm/Config.in"
    source "$BR2_EXTERNAL_SWIFTLINUXPORTS_PATH/package/games/libretro-snes9x/Config.in"
    source "$BR2_EXTERNAL_SWIFTLINUXPORTS_PATH/package/games/love/Config.in"
    source "$BR2_EXTERNAL_SWIFTLINUXPORTS_PATH/package/games/lutris/Config.in"
    source "$BR2_EXTERNAL_SWIFTLINUXPORTS_PATH/package/games/portmaster/Config.in"
    source "$BR2_EXTERNAL_SWIFTLINUXPORTS_PATH/package/games/retroarch/Config.in"
    source "$BR2_EXTERNAL_SWIFTLINUXPORTS_PATH/package/games/ruffle/Config.in"
    source "$BR2_EXTERNAL_SWIFTLINUXPORTS_PATH/package/games/solarus-engine/Config.in"
    source "$BR2_EXTERNAL_SWIFTLINUXPORTS_PATH/package/games/steam/Config.in"

endmenu

menu "libs"

    source "$BR2_EXTERNAL_SWIFTLINUXPORTS_PATH/package/libs/libgtk4/Config.in"
    source "$BR2_EXTERNAL_SWIFTLINUXPORTS_PATH/package/libs/graphene/Config.in"
    source "$BR2_EXTERNAL_SWIFTLINUXPORTS_PATH/package/libs/appstream/Config.in"
    source "$BR2_EXTERNAL_SWIFTLINUXPORTS_PATH/package/libs/colord-gtk/Config.in"
    source "$BR2_EXTERNAL_SWIFTLINUXPORTS_PATH/package/libs/dconf/Config.in"
    source "$BR2_EXTERNAL_SWIFTLINUXPORTS_PATH/package/libs/elogind/Config.in"
    source "$BR2_EXTERNAL_SWIFTLINUXPORTS_PATH/package/libs/evolution-data-server/Config.in"
    source "$BR2_EXTERNAL_SWIFTLINUXPORTS_PATH/package/libs/exo/Config.in"
    source "$BR2_EXTERNAL_SWIFTLINUXPORTS_PATH/package/libs/freeimage/Config.in"
    source "$BR2_EXTERNAL_SWIFTLINUXPORTS_PATH/package/libs/garcon/Config.in"
    source "$BR2_EXTERNAL_SWIFTLINUXPORTS_PATH/package/libs/gcr4/Config.in"
    source "$BR2_EXTERNAL_SWIFTLINUXPORTS_PATH/package/libs/geoclue2/Config.in"
    source "$BR2_EXTERNAL_SWIFTLINUXPORTS_PATH/package/libs/geocode-glib/Config.in"
    source "$BR2_EXTERNAL_SWIFTLINUXPORTS_PATH/package/libs/gexiv2/Config.in"
    source "$BR2_EXTERNAL_SWIFTLINUXPORTS_PATH/package/libs/gjs/Config.in"
    source "$BR2_EXTERNAL_SWIFTLINUXPORTS_PATH/package/libs/gl4es/Config.in"
    source "$BR2_EXTERNAL_SWIFTLINUXPORTS_PATH/package/libs/glslang/Config.in"
    source "$BR2_EXTERNAL_SWIFTLINUXPORTS_PATH/package/libs/gnome-autoar/Config.in"
    source "$BR2_EXTERNAL_SWIFTLINUXPORTS_PATH/package/libs/gnome-bluetooth/Config.in"
    source "$BR2_EXTERNAL_SWIFTLINUXPORTS_PATH/package/libs/gnome-desktop/Config.in"
    source "$BR2_EXTERNAL_SWIFTLINUXPORTS_PATH/package/libs/gnome-online-accounts/Config.in"
    source "$BR2_EXTERNAL_SWIFTLINUXPORTS_PATH/package/libs/gsound/Config.in"
    source "$BR2_EXTERNAL_SWIFTLINUXPORTS_PATH/package/libs/gtksourceview5/Config.in"
    source "$BR2_EXTERNAL_SWIFTLINUXPORTS_PATH/package/libs/ibus/Config.in"
    source "$BR2_EXTERNAL_SWIFTLINUXPORTS_PATH/package/libs/libadwaita/Config.in"
    source "$BR2_EXTERNAL_SWIFTLINUXPORTS_PATH/package/libs/libei/Config.in"
    source "$BR2_EXTERNAL_SWIFTLINUXPORTS_PATH/package/libs/libfreeaptx/Config.in"
    source "$BR2_EXTERNAL_SWIFTLINUXPORTS_PATH/package/libs/libgtop/Config.in"
    source "$BR2_EXTERNAL_SWIFTLINUXPORTS_PATH/package/libs/libgusb/Config.in"
    source "$BR2_EXTERNAL_SWIFTLINUXPORTS_PATH/package/libs/libgweather/Config.in"
    source "$BR2_EXTERNAL_SWIFTLINUXPORTS_PATH/package/libs/liblc3/Config.in"
    source "$BR2_EXTERNAL_SWIFTLINUXPORTS_PATH/package/libs/liblcf/Config.in"
    source "$BR2_EXTERNAL_SWIFTLINUXPORTS_PATH/package/libs/libldac/Config.in"
    source "$BR2_EXTERNAL_SWIFTLINUXPORTS_PATH/package/libs/libnma/Config.in"
    source "$BR2_EXTERNAL_SWIFTLINUXPORTS_PATH/package/libs/libnotify/Config.in"
    source "$BR2_EXTERNAL_SWIFTLINUXPORTS_PATH/package/libs/libportal/Config.in"
    source "$BR2_EXTERNAL_SWIFTLINUXPORTS_PATH/package/libs/librest/Config.in"
    source "$BR2_EXTERNAL_SWIFTLINUXPORTS_PATH/package/libs/libwacom/Config.in"
    source "$BR2_EXTERNAL_SWIFTLINUXPORTS_PATH/package/libs/libwnck/Config.in"
    source "$BR2_EXTERNAL_SWIFTLINUXPORTS_PATH/package/libs/libxfce4ui/Config.in"
    source "$BR2_EXTERNAL_SWIFTLINUXPORTS_PATH/package/libs/libxfce4util/Config.in"
    source "$BR2_EXTERNAL_SWIFTLINUXPORTS_PATH/package/libs/localsearch/Config.in"
    source "$BR2_EXTERNAL_SWIFTLINUXPORTS_PATH/package/libs/luajit-embed/Config.in"
    source "$BR2_EXTERNAL_SWIFTLINUXPORTS_PATH/package/libs/mozjs128/Config.in"
    source "$BR2_EXTERNAL_SWIFTLINUXPORTS_PATH/package/libs/python-pygame2/Config.in"
    source "$BR2_EXTERNAL_SWIFTLINUXPORTS_PATH/package/libs/sdl3/Config.in"
    source "$BR2_EXTERNAL_SWIFTLINUXPORTS_PATH/package/libs/shaderc/Config.in"
    source "$BR2_EXTERNAL_SWIFTLINUXPORTS_PATH/package/libs/tinysparql/Config.in"
    source "$BR2_EXTERNAL_SWIFTLINUXPORTS_PATH/package/libs/totem-pl-parser/Config.in"
    source "$BR2_EXTERNAL_SWIFTLINUXPORTS_PATH/package/libs/udisks2/Config.in"
    source "$BR2_EXTERNAL_SWIFTLINUXPORTS_PATH/package/libs/vte4/Config.in"
    source "$BR2_EXTERNAL_SWIFTLINUXPORTS_PATH/package/libs/xfconf/Config.in"

endmenu

menu "tools"

    source "$BR2_EXTERNAL_SWIFTLINUXPORTS_PATH/package/tools/box64/Config.in"
    source "$BR2_EXTERNAL_SWIFTLINUXPORTS_PATH/package/tools/box86/Config.in"
    source "$BR2_EXTERNAL_SWIFTLINUXPORTS_PATH/package/tools/flatpak/Config.in"
    source "$BR2_EXTERNAL_SWIFTLINUXPORTS_PATH/package/tools/grim/Config.in"
    source "$BR2_EXTERNAL_SWIFTLINUXPORTS_PATH/package/tools/wine-prebuilt/Config.in"

endmenu

endmenu
```

## package/apps/tecla/Config.in
```kconfig
config BR2_PACKAGE_TECLA
	bool "tecla"
	depends on BR2_PACKAGE_LIBGTK4
	select BR2_PACKAGE_LIBADWAITA
	select BR2_PACKAGE_LIBXKBCOMMON
	help
	  Keyboard layout viewer for GNOME. Settings' keyboard panel
	  launches it to preview a layout, and finds it through the
	  tecla pkg-config file's app variable; without the package
	  gnome-control-center falls back to a wrap subproject that a
	  Buildroot build cannot fetch.

	  https://gitlab.gnome.org/GNOME/tecla
```

## package/apps/waydroid/Config.in
```kconfig
config BR2_PACKAGE_WAYDROID_ARCH_SUPPORTS
	bool
	# Upstream builds Android images for these four only.
	default y if BR2_i386 || BR2_x86_64 || BR2_arm || BR2_aarch64

config BR2_PACKAGE_WAYDROID
	bool "waydroid"
	depends on BR2_PACKAGE_WAYDROID_ARCH_SUPPORTS
	depends on BR2_PACKAGE_PYTHON3
	depends on BR2_PACKAGE_DBUS # dbus-python
	depends on BR2_USE_MMU # lxc, libglib2
	depends on BR2_USE_WCHAR # libglib2
	depends on BR2_TOOLCHAIN_HAS_THREADS # lxc, libglib2
	depends on !BR2_STATIC_LIBS # lxc
	depends on BR2_TOOLCHAIN_HEADERS_AT_LEAST_3_0 # lxc: setns()
	depends on BR2_TOOLCHAIN_GCC_AT_LEAST_4_9 # python-gobject
	depends on BR2_HOST_GCC_AT_LEAST_8 # python-gobject
	depends on BR2_TOOLCHAIN_USES_GLIBC # python-gobject
	depends on BR2_PACKAGE_GOBJECT_INTROSPECTION_ARCH_SUPPORTS # python-gobject
	select BR2_PACKAGE_LXC
	select BR2_PACKAGE_PYTHON_GBINDER
	select BR2_PACKAGE_DBUS_PYTHON
	select BR2_PACKAGE_PYTHON_GOBJECT
	select BR2_PACKAGE_PYTHON3_SSL # urllib: OTA image download
	select BR2_PACKAGE_PYTHON3_ZLIB # zipfile/tarfile: unpacking them
	select BR2_PACKAGE_DNSMASQ # container DHCP/DNS
	select BR2_PACKAGE_IPTABLES # container NAT
	select BR2_PACKAGE_KMOD
	select BR2_PACKAGE_KMOD_TOOLS # modprobe binder_linux
	help
	  Waydroid runs a full Android system in an LXC container on a
	  Wayland desktop, with the Android apps appearing as ordinary
	  windows. Rendering goes through Android's own mesa, so it wants
	  a GPU with a working GL driver; software rendering otherwise.

	  Two halves. The privileged container manager owns
	  id.waydro.Container on the system bus and is started by an init
	  script (there is no systemd unit on this image). The per-user
	  session is "waydroid session start", launched from the
	  graphical session by the autostart entry this installs.

	  Only waydroid itself is packaged. The Android system and vendor
	  images are several hundred MB and are not included: "waydroid
	  init" downloads them on first run, which needs working
	  networking and a writable /var/lib/waydroid.

	  https://waydro.id

comment "waydroid needs a glibc toolchain w/ wchar, threads, dynamic library, headers >= 3.0, gcc >= 4.9, host gcc >= 8"
	depends on BR2_PACKAGE_WAYDROID_ARCH_SUPPORTS
	depends on BR2_USE_MMU
	depends on BR2_PACKAGE_GOBJECT_INTROSPECTION_ARCH_SUPPORTS
	depends on !BR2_USE_WCHAR || !BR2_TOOLCHAIN_HAS_THREADS \
		|| BR2_STATIC_LIBS || !BR2_TOOLCHAIN_HEADERS_AT_LEAST_3_0 \
		|| !BR2_TOOLCHAIN_GCC_AT_LEAST_4_9 || !BR2_HOST_GCC_AT_LEAST_8 \
		|| !BR2_TOOLCHAIN_USES_GLIBC
```

## package/daemons/localsearch/Config.in
```kconfig
config BR2_PACKAGE_LOCALSEARCH
	bool "localsearch"
	depends on BR2_PACKAGE_TINYSPARQL
	depends on BR2_PACKAGE_GOBJECT_INTROSPECTION
	select BR2_PACKAGE_LIBGUDEV
	select BR2_PACKAGE_LIBSECCOMP
	help
	  File indexer over tinysparql (formerly tracker-miners);
	  nautilus search uses its index when present.

	  https://gitlab.gnome.org/GNOME/localsearch
```

## package/games/ccleste/Config.in
```kconfig
config BR2_PACKAGE_CCLESTE
	bool "ccleste"
	select BR2_PACKAGE_SDL2
	select BR2_PACKAGE_SDL2_MIXER
	select BR2_PACKAGE_TREMOR
	help
	  ccleste: a C source port of Celeste Classic, the PICO-8
	  original Maddy Thorson and Noel Berry wrote for Ludum Dare -
	  the cart's Lua translated to C by hand, so the game runs
	  natively rather than under a PICO-8 emulator. The game logic
	  needs nothing but libc; SDL2 and SDL2_mixer provide the video
	  and audio frontend.

	  Tremor is selected because it is the only Ogg Vorbis decoder
	  Buildroot's sdl2_mixer can be built against, and the
	  soundtrack ships as .ogg.

	  https://github.com/lemon32767/ccleste
```
