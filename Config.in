## package/games/nanosaur2/Config.in
```kconfig
config BR2_PACKAGE_NANOSAUR2
	bool "nanosaur2"
	depends on BR2_INSTALL_LIBSTDCPP # C++20
	depends on BR2_TOOLCHAIN_GCC_AT_LEAST_10 # C++20
	depends on BR2_TOOLCHAIN_HAS_THREADS # sdl3
	depends on !BR2_STATIC_LIBS # sdl3
	depends on BR2_PACKAGE_HAS_LIBGL
	select BR2_PACKAGE_SDL3
	select BR2_PACKAGE_SDL3_OPENGL
	help
	  Nanosaur II: Hatchling, Pangea Software's 2004 sequel to
	  Nanosaur, ported to modern systems by Iliyas Jorio with
	  permission from Pangea. You fly an armed pterodactyl through a
	  three level adventure mode and six two-player levels.

	  The game assets ship with the source, so nothing has to be
	  supplied on the target - but they take up about 113MB.

	  The renderer is fixed-function desktop OpenGL, so this needs a
	  full GL provider; GLES alone will not do.

	  https://github.com/jorio/Nanosaur2

comment "nanosaur2 needs a toolchain w/ C++20, threads, dynamic library, and an OpenGL provider"
	depends on !BR2_INSTALL_LIBSTDCPP || !BR2_TOOLCHAIN_GCC_AT_LEAST_10 \
		|| !BR2_TOOLCHAIN_HAS_THREADS || BR2_STATIC_LIBS \
		|| !BR2_PACKAGE_HAS_LIBGL
```

## package/libs/game-music-emu/Config.in
```kconfig
config BR2_PACKAGE_GAME_MUSIC_EMU
	bool "game-music-emu"
	depends on BR2_INSTALL_LIBSTDCPP
	select BR2_PACKAGE_ZLIB
	help
	  game-music-emu is a collection of video game music file
	  emulators, playing AY, GBS, GYM, HES, KSS, NSF, NSFE, SAP, SPC
	  and VGM/VGZ files.

	  https://github.com/libgme/game-music-emu

comment "game-music-emu needs a toolchain w/ C++"
	depends on !BR2_INSTALL_LIBSTDCPP
```

## package/libs/libavif/Config.in
```kconfig
config BR2_PACKAGE_LIBAVIF
	bool "libavif"
	depends on !BR2_STATIC_LIBS # dav1d
	depends on BR2_TOOLCHAIN_HAS_THREADS # dav1d
	select BR2_HOST_CMAKE_AT_LEAST_3_22
	select BR2_PACKAGE_DAV1D
	help
	  libavif is the reference library for the AVIF image format. It
	  decodes through dav1d; encoding needs an AV1 encoder, which
	  Buildroot does not package.

	  https://github.com/AOMediaCodec/libavif

comment "libavif needs a toolchain w/ threads, dynamic library"
	depends on !BR2_TOOLCHAIN_HAS_THREADS || BR2_STATIC_LIBS
```

## package/libs/libgbinder/Config.in
```kconfig
config BR2_PACKAGE_LIBGBINDER
	bool "libgbinder"
	select BR2_PACKAGE_LIBGLIB2
	select BR2_PACKAGE_LIBGLIBUTIL
	help
	  libgbinder: a GLib-style client for Android's binder IPC. It
	  talks to /dev/binder (or the nodes allocated out of binderfs)
	  and is how a Linux userspace process reaches the services
	  inside an Android container.

	  Required by waydroid, through its Python bindings.

	  https://github.com/mer-hybris/libgbinder
```

## package/libs/libglibutil/Config.in
```kconfig
config BR2_PACKAGE_LIBGLIBUTIL
	bool "libglibutil"
	select BR2_PACKAGE_LIBGLIB2
	help
	  libglibutil: the small collection of GLib helpers (string and
	  byte-array utilities, idle/timeout wrappers, weak pointers,
	  logging) that the Sailfish/Mer libraries are written against.
	  Here it is the base of the libgbinder stack.

	  https://github.com/sailfishos/libglibutil
```

## package/libs/libhandy/Config.in
```kconfig
config BR2_PACKAGE_LIBHANDY
	bool "libhandy"
	depends on BR2_PACKAGE_LIBGTK3
	select BR2_PACKAGE_FRIBIDI
	help
	  Adaptive widgets for GTK 3 applications - the GTK 3 counterpart
	  of libadwaita. gnome-disk-utility is built on it.

	  https://gitlab.gnome.org/GNOME/libhandy
```

## package/libs/libxmp/Config.in
```kconfig
config BR2_PACKAGE_LIBXMP
	bool "libxmp"
	help
	  libxmp is a module rendering library, playing MOD, S3M, XM, IT
	  and around forty other module formats.

	  https://github.com/libxmp/libxmp
```

## package/libs/lzfse/Config.in
```kconfig
config BR2_PACKAGE_LZFSE
	bool "lzfse"
	help
	  Apple's LZFSE compression library, and the lzfse command line
	  tool that wraps it. LZFSE is the algorithm behind Apple
	  Archive and the compression Apple platforms expose through
	  libcompression; it also decodes LZVN, which is what an
	  encrypted iOS/macOS kernelcache is packed with.

	  https://github.com/lzfse/lzfse
```

## package/libs/plutosvg/Config.in
```kconfig
config BR2_PACKAGE_PLUTOSVG
	bool "plutosvg"
	select BR2_PACKAGE_FREETYPE
	select BR2_PACKAGE_PLUTOVG
	help
	  plutosvg is a small SVG rendering library built on plutovg. It
	  is built with the FreeType integration enabled, which is what
	  provides OpenType-SVG (colour emoji) rendering.

	  https://github.com/sammycage/plutosvg
```

## package/libs/sdl3_image/Config.in
```kconfig
config BR2_PACKAGE_SDL3_IMAGE
	bool "sdl3_image"
	depends on BR2_PACKAGE_SDL3
	help
	  SDL3_image is an image file loading library for SDL3. It loads
	  images as SDL surfaces and supports AVIF, BMP, GIF, JPEG, LBM,
	  PCX, PNG, PNM, QOI, SVG, TGA, TIFF, WEBP, XCF, XPM and XV.

	  Which of the formats that need a helper library are built
	  depends on the image libraries enabled in the configuration
	  (jpeg, libpng, tiff, webp, libjxl, libavif).

	  https://github.com/libsdl-org/SDL_image
```

## package/libs/sdl3_mixer/Config.in
```kconfig
config BR2_PACKAGE_SDL3_MIXER
	bool "sdl3_mixer"
	depends on BR2_PACKAGE_SDL3
	help
	  SDL3_mixer is a multi-channel audio mixer library for SDL3. It
	  plays AIFF, AU, VOC and WAVE samples, MIDI through the built-in
	  timidity, and MP3, Ogg Vorbis and FLAC through the bundled dr_mp3,
	  stb_vorbis and dr_flac decoders.

	  The higher quality decoders are used instead when their libraries
	  are enabled in the Buildroot configuration (flac, mpg123,
	  libvorbis or tremor, opusfile, wavpack, fluidsynth).

	  https://github.com/libsdl-org/SDL_mixer
```

## package/libs/sdl3_ttf/Config.in
```kconfig
config BR2_PACKAGE_SDL3_TTF
	bool "sdl3_ttf"
	depends on BR2_PACKAGE_SDL3
	select BR2_PACKAGE_FREETYPE
	help
	  SDL3_ttf is a TrueType font rendering library for SDL3. Text
	  shaping through harfbuzz is used when harfbuzz is enabled, and
	  colour emoji are rendered when plutosvg is enabled.

	  https://github.com/libsdl-org/SDL_ttf
```

## package/tools/blueprint-compiler/Config.in
```kconfig
config BR2_PACKAGE_HOST_BLUEPRINT_COMPILER
	bool "host blueprint-compiler"
	help
	  Compiler for GNOME's Blueprint markup language, which builds
	  .blp files into the GTK .ui XML that GtkBuilder loads. A build
	  tool only - it runs on the build machine and installs nothing
	  on the target.

	  Buildroot sources only Config.in from an external tree, with no
	  Config.in.host equivalent, so this host-only symbol appears here
	  among the target packages rather than under Host utilities.

	  https://gitlab.gnome.org/jwestman/blueprint-compiler
```

## package/tools/xar/Config.in
```kconfig
config BR2_PACKAGE_XAR
	bool "xar"
	depends on !BR2_STATIC_LIBS # builds and links a shared libxar
	select BR2_PACKAGE_LIBXML2
	select BR2_PACKAGE_OPENSSL
	select BR2_PACKAGE_ZLIB
	help
	  xar (eXtensible ARchiver) is a command-line archiving tool and
	  library built around an XML table of contents, the format macOS
	  installer packages (.pkg) and update packages use.

	  https://github.com/mackyle/xar
```
