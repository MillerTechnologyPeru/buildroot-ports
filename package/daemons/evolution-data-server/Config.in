## package/games/es-theme-art-book-next/Config.in
```kconfig
config BR2_PACKAGE_ES_THEME_ART_BOOK_NEXT
	bool "es-theme-art-book-next"
	depends on BR2_PACKAGE_EMULATIONSTATION
	help
	  Art Book Next, a theme for EmulationStation: system artwork
	  and logos, game list layouts for every common aspect ratio
	  (including the 4:3 and 1:1 handheld panels), and menu
	  sounds. Without a theme the frontend falls back to its plain
	  built-in layout of system names.

	  Only the default system artwork set is installed; the other
	  five sets in the theme add about 250 MB.

	  https://github.com/anthonycaccese/art-book-next-es
```

## package/games/libretro-beetle-pce-fast/Config.in
```kconfig
config BR2_PACKAGE_LIBRETRO_BEETLE_PCE_FAST
	bool "libretro-beetle-pce-fast"
	depends on BR2_PACKAGE_RETROARCH
	help
	  Beetle PCE Fast libretro core (Mednafen's pce_fast): NEC PC
	  Engine / TurboGrafx-16 and PC Engine CD emulation. HuCard
	  games need nothing else; CD games need the System Card BIOS
	  (syscard3.pce) in the RetroArch system directory.

	  https://github.com/libretro/beetle-pce-fast-libretro
```

## package/games/libretro-genesis-plus-gx/Config.in
```kconfig
config BR2_PACKAGE_LIBRETRO_GENESIS_PLUS_GX
	bool "libretro-genesis-plus-gx"
	depends on BR2_PACKAGE_RETROARCH
	help
	  Genesis Plus GX libretro core: Sega Mega Drive / Genesis,
	  Master System, Game Gear and Mega-CD emulation, accurate and
	  light enough for the low-end handhelds.

	  Its license allows redistribution, but not in a commercial
	  product or activity.

	  https://github.com/libretro/Genesis-Plus-GX
```

## package/games/retroarch-joypads/Config.in
```kconfig
config BR2_PACKAGE_RETROARCH_JOYPADS
	bool "retroarch-joypads"
	depends on BR2_PACKAGE_RETROARCH
	help
	  RetroArch controller profiles: libretro's collection plus the
	  handheld profiles of upstream's distribution, with its Select
	  hotkeys (Select+Start quits the game, Select+X opens the
	  menu). Installed to /usr/share/libretro/autoconfig.

	  https://github.com/libretro/retroarch-joypad-autoconfig
```

## package/games/roms-homebrew/Config.in
```kconfig
menuconfig BR2_PACKAGE_ROMS_HOMEBREW
	bool "roms-homebrew"
	help
	  Freely licensed homebrew games for the consoles the
	  EmulationStation frontend emulates, so a fresh image has
	  something to play. Each game is downloaded from its own
	  published release and installed to
	  /usr/share/roms-homebrew/<system>/; the image copies them into
	  the user's ROM folders on first boot.

	  Each game is its own package, so each keeps its own license
	  files; all of them are on by default.

if BR2_PACKAGE_ROMS_HOMEBREW
	source "$BR2_EXTERNAL_SWIFTLINUXPORTS_PATH/package/games/roms-homebrew/roms-homebrew-ucity/Config.in"
	source "$BR2_EXTERNAL_SWIFTLINUXPORTS_PATH/package/games/roms-homebrew/roms-homebrew-runner/Config.in"
	source "$BR2_EXTERNAL_SWIFTLINUXPORTS_PATH/package/games/roms-homebrew/roms-homebrew-roborun/Config.in"
	source "$BR2_EXTERNAL_SWIFTLINUXPORTS_PATH/package/games/roms-homebrew/roms-homebrew-gothicvania/Config.in"
	source "$BR2_EXTERNAL_SWIFTLINUXPORTS_PATH/package/games/roms-homebrew/roms-homebrew-2048/Config.in"
	source "$BR2_EXTERNAL_SWIFTLINUXPORTS_PATH/package/games/roms-homebrew/roms-homebrew-lutro-pong/Config.in"
	source "$BR2_EXTERNAL_SWIFTLINUXPORTS_PATH/package/games/roms-homebrew/roms-homebrew-bass/Config.in"
endif
```

## package/games/roms-homebrew/roms-homebrew-2048/Config.in
```kconfig
config BR2_PACKAGE_ROMS_HOMEBREW_2048
	bool "2048 (Game Boy)"
	default y
	help
	  2048, the sliding-tile puzzle, for the Game Boy.

	  https://github.com/wyattferguson/2048-gb
```

## package/games/roms-homebrew/roms-homebrew-bass/Config.in
```kconfig
config BR2_PACKAGE_ROMS_HOMEBREW_BASS
	bool "Beneath a Steel Sky (ScummVM)"
	default y
	depends on BR2_PACKAGE_LIBRETRO_SCUMMVM
	help
	  Beneath a Steel Sky, Revolution Software's 1994 science
	  fiction adventure, released as freeware for ScummVM. The
	  floppy version (8.8 MB unpacked).

	  https://www.scummvm.org/games/#games-sky
```

## package/games/roms-homebrew/roms-homebrew-gothicvania/Config.in
```kconfig
config BR2_PACKAGE_ROMS_HOMEBREW_GOTHICVANIA
	bool "Gothicvania (SNES)"
	default y
	help
	  Gothicvania, an action platformer, for the SNES.

	  https://github.com/donth77/snes-homebrew
```

## package/games/roms-homebrew/roms-homebrew-lutro-pong/Config.in
```kconfig
config BR2_PACKAGE_ROMS_HOMEBREW_LUTRO_PONG
	bool "Pong (Lutro)"
	default y
	depends on BR2_PACKAGE_LIBRETRO_LUTRO
	help
	  Pong for the Lutro Lua game framework.

	  https://github.com/libretro/lutro-pong
```

## package/games/roms-homebrew/roms-homebrew-roborun/Config.in
```kconfig
config BR2_PACKAGE_ROMS_HOMEBREW_ROBORUN
	bool "RoboRun (NES)"
	default y
	help
	  RoboRun, a platformer, for the NES.

	  https://github.com/heaven-hm/roborun-nes
```

## package/games/roms-homebrew/roms-homebrew-runner/Config.in
```kconfig
config BR2_PACKAGE_ROMS_HOMEBREW_RUNNER
	bool "Runner (NES)"
	default y
	help
	  Runner, an endless runner, for the NES.

	  https://github.com/zorchenhimer/nes-runner
```

## package/games/roms-homebrew/roms-homebrew-ucity/Config.in
```kconfig
config BR2_PACKAGE_ROMS_HOMEBREW_UCITY
	bool "uCity (Game Boy Color)"
	default y
	help
	  uCity, a city-building game, for the Game Boy Color.

	  https://github.com/AntonioND/ucity
```

## package/libs/cacao/Config.in
```kconfig
config BR2_PACKAGE_CACAO
	bool "cacao"
	depends on BR2_PACKAGE_SWIFT
	depends on BR2_USE_MMU # silica, cairo
	depends on !BR2_STATIC_LIBS # sdl3
	depends on BR2_TOOLCHAIN_HAS_THREADS # sdl3
	depends on BR2_PACKAGE_WAYLAND
	select BR2_PACKAGE_SWIFT_FOUNDATION
	select BR2_PACKAGE_SILICA
	select BR2_PACKAGE_SWIFT_SDL
	select BR2_PACKAGE_SDL3
	help
	  Cacao is the SwiftUI API implemented in Swift, drawing with
	  Silica and SDL3. Sources written for SwiftUI compile against
	  it unchanged, through the SwiftUI and Combine modules it
	  installs.

	  Its modules (CacaoRender, Cacao, CacaoCompositor, CacaoHost,
	  CacaoSDL, CacaoScrollPhysics, SwiftUI, Combine) are built as
	  shared libraries with library evolution and installed into
	  the Swift resource directory, like the system's own
	  frameworks.

	  The @Entry macro's compiler plugin is built for the build
	  machine (host-cacao-macros) and installed beside the host
	  Swift compiler, which loads it on its own.

	  https://github.com/PureSwift/Cacao

if BR2_PACKAGE_CACAO

config BR2_PACKAGE_CACAO_DEMO
	bool "install the demo app"
	help
	  Install CacaoDemo, a catalog app that exercises Cacao's
	  controls, lists, shapes, effects, animations and gestures.

endif

comment "cacao needs the Swift runtime (the buildroot-swift external) and wayland"
	depends on !BR2_PACKAGE_SWIFT || !BR2_PACKAGE_WAYLAND
```

## package/libs/gnome-backgrounds/Config.in
```kconfig
config BR2_PACKAGE_GNOME_BACKGROUNDS
	bool "gnome-backgrounds"
	help
	  The default GNOME desktop wallpapers, including the Adwaita
	  set that gsettings-desktop-schemas names as the default
	  background. Without them the shell draws a flat colour.

	  About 38MB of images.

	  https://gitlab.gnome.org/GNOME/gnome-backgrounds
```

## package/libs/silica/Config.in
```kconfig
config BR2_PACKAGE_SILICA
	bool "silica"
	depends on BR2_PACKAGE_SWIFT
	depends on BR2_USE_MMU # cairo
	select BR2_PACKAGE_SWIFT_FOUNDATION
	select BR2_PACKAGE_SWIFT_CAIRO
	select BR2_PACKAGE_SWIFT_FONTCONFIG
	help
	  Silica is the Core Graphics API in Swift, drawing with cairo:
	  CGContext, CGPath, CGImage, CGFont and the UIKit drawing
	  types.

	  Its Silica and SilicaCairo modules are built as shared
	  libraries with library evolution and installed into the
	  Swift resource directory, like the system's own frameworks.

	  https://github.com/PureSwift/Silica

comment "silica needs the Swift runtime (the buildroot-swift external)"
	depends on !BR2_PACKAGE_SWIFT
```

## package/libs/swift-cairo/Config.in
```kconfig
config BR2_PACKAGE_SWIFT_CAIRO
	bool "swift-cairo"
	depends on BR2_PACKAGE_SWIFT
	depends on BR2_USE_MMU # cairo
	select BR2_PACKAGE_SWIFT_FOUNDATION
	select BR2_PACKAGE_SWIFT_FONTCONFIG
	select BR2_PACKAGE_CAIRO
	select BR2_PACKAGE_CAIRO_PNG
	select BR2_PACKAGE_CAIRO_PDF
	select BR2_PACKAGE_CAIRO_SVG
	select BR2_PACKAGE_FREETYPE
	help
	  The Cairo Swift module from PureSwift: a Swift interface to
	  the cairo 2D graphics library, with image, PNG, PDF and SVG
	  surfaces and FreeType fonts.

	  Installed into the Swift resource directory, so Swift code
	  finds it with a plain "import Cairo".

	  https://github.com/PureSwift/Cairo

comment "swift-cairo needs the Swift runtime (the buildroot-swift external)"
	depends on !BR2_PACKAGE_SWIFT
```

## package/libs/swift-fontconfig/Config.in
```kconfig
config BR2_PACKAGE_SWIFT_FONTCONFIG
	bool "swift-fontconfig"
	depends on BR2_PACKAGE_SWIFT
	select BR2_PACKAGE_SWIFT_FOUNDATION
	select BR2_PACKAGE_FONTCONFIG
	select BR2_PACKAGE_FREETYPE
	help
	  The FontConfig Swift module from PureSwift: a Swift interface
	  to fontconfig, for matching fonts by family, weight and slant.

	  Installed into the Swift resource directory, so Swift code
	  finds it with a plain "import FontConfig".

	  https://github.com/PureSwift/FontConfig

comment "swift-fontconfig needs the Swift runtime (the buildroot-swift external)"
	depends on !BR2_PACKAGE_SWIFT
```

## package/libs/swift-sdl/Config.in
```kconfig
config BR2_PACKAGE_SWIFT_SDL
	bool "swift-sdl"
	depends on BR2_PACKAGE_SWIFT
	depends on !BR2_STATIC_LIBS # sdl3
	depends on BR2_TOOLCHAIN_HAS_THREADS # sdl3
	select BR2_PACKAGE_SDL3
	help
	  The CSDL3 module from PureSwift's SDL package, which lets
	  Swift code call SDL3 with "import CSDL3".

	  Only the C module is installed (a module map over SDL3's
	  headers, into the Swift resource directory); the package's
	  Swift wrappers are not built.

	  https://github.com/PureSwift/SDL

comment "swift-sdl needs the Swift runtime (the buildroot-swift external)"
	depends on !BR2_PACKAGE_SWIFT
```

## package/tools/perry/Config.in
```kconfig
config BR2_PACKAGE_PERRY_ARCH_SUPPORTS
	bool
	default y if BR2_aarch64 || BR2_x86_64
	default y if BR2_arm && BR2_ARM_CPU_ARMV7A # perry32
	default y if BR2_powerpc

config BR2_PACKAGE_PERRY
	bool "perry"
	depends on BR2_PACKAGE_PERRY_ARCH_SUPPORTS
	depends on BR2_PACKAGE_SWIFT
	depends on !BR2_STATIC_LIBS # sdl3
	depends on BR2_USE_WCHAR # sdl3
	depends on BR2_TOOLCHAIN_HAS_THREADS # sdl3, libheif
	depends on BR2_INSTALL_LIBSTDCPP # libheif
	depends on BR2_TOOLCHAIN_GCC_AT_LEAST_10 # libheif
	depends on !BR2_TOOLCHAIN_HAS_BINUTILS_BUG_30730 # libheif
	depends on BR2_PACKAGE_OPENBLAS_ARCH_SUPPORTS
	depends on BR2_USE_MMU # dbus
	select BR2_PACKAGE_SWIFT_FOUNDATION
	select BR2_PACKAGE_SDL3
	select BR2_PACKAGE_CAIRO
	select BR2_PACKAGE_CAIRO_PNG
	select BR2_PACKAGE_FONTCONFIG
	select BR2_PACKAGE_FREETYPE
	select BR2_PACKAGE_LIBXML2
	select BR2_PACKAGE_LIBPNG
	select BR2_PACKAGE_JPEG
	select BR2_PACKAGE_GIFLIB
	select BR2_PACKAGE_WEBP
	select BR2_PACKAGE_LIBHEIF
	select BR2_PACKAGE_ZLIB
	select BR2_PACKAGE_BZIP2
	select BR2_PACKAGE_XZ
	select BR2_PACKAGE_LZ4
	select BR2_PACKAGE_BROTLI
	select BR2_PACKAGE_EXPAT
	select BR2_PACKAGE_SQLITE
	select BR2_PACKAGE_OPENBLAS
	select BR2_PACKAGE_DBUS
	# JavaScriptCore's provider, on 64-bit, wherever webkitgtk can be built
	select BR2_PACKAGE_WEBKITGTK if (BR2_aarch64 || BR2_x86_64) && \
		BR2_PACKAGE_WEBKITGTK_ARCH_SUPPORTS && BR2_PACKAGE_HAS_LIBEGL && \
		(BR2_PACKAGE_LIBGTK3 || BR2_PACKAGE_LIBGTK4) && \
		BR2_TOOLCHAIN_HAS_THREADS_NPTL && BR2_TOOLCHAIN_GCC_AT_LEAST_11 && \
		BR2_HOST_GCC_AT_LEAST_7 && !BR2_BINFMT_FLAT
	help
	  Perry runs Mac programs' Mach-O binaries on Linux natively:
	  their own code runs on the CPU, and the libraries and
	  frameworks they call are Linux libraries ("providers")
	  written mostly in Swift.

	  It installs the loader and its providers in /usr/lib/perry,
	  where the loader finds them beside itself. No Swift: Darwin's
	  Swift runtime and Perry's Swift overlays are compiled on a Mac
	  and not included.

	  On arm64 and x86_64, perry runs arm64 iOS and Mac programs, and
	  x86_64 Mac ones, with every provider but Carbon's: JavaScriptCore's
	  too where webkitgtk can be built (with a GTK and EGL), which it
	  then selects.

	  On 32-bit ARM it builds perry32, which runs armv7 iOS programs
	  as a 32-bit process, with the providers of what iOS 10, the last
	  iOS to run armv7 programs, has, and nothing else. In
	  a 32-bit companion it becomes the image's /usr/lib32/perry, and
	  perry hands armv7 programs to it.

	  On 32-bit PowerPC, perry runs ppc Mac OS X 10.3 to 10.5
	  programs, translating between Darwin's ppc calling convention
	  and Linux's, with the providers of what Mac OS X 10.5 has
	  (Carbon's among them) and nothing later; but not Security's,
	  whose BoringSSL is little-endian only, or Core Data's, which
	  Swift's compiler cannot yet build for PowerPC.

	  Building it resolves Perry's Swift package dependencies and
	  fetches SQLite, lzfse and swift-cmark, so it needs network
	  access.

	  https://github.com/MillerTechnologyPeru/Perry

comment "perry needs the Swift runtime (the buildroot-swift external)"
	depends on BR2_PACKAGE_PERRY_ARCH_SUPPORTS
	depends on !BR2_PACKAGE_SWIFT

comment "perry needs a toolchain w/ C++, wchar, threads, dynamic library, gcc >= 10"
	depends on BR2_PACKAGE_PERRY_ARCH_SUPPORTS
	depends on BR2_PACKAGE_SWIFT
	depends on !BR2_INSTALL_LIBSTDCPP || !BR2_USE_WCHAR || \
		!BR2_TOOLCHAIN_HAS_THREADS || BR2_STATIC_LIBS || \
		!BR2_TOOLCHAIN_GCC_AT_LEAST_10
```
